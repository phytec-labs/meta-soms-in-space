## conf/layer.conf
```bitbake
# We have a conf and classes directory, add to BBPATH
BBPATH .= ":${LAYERDIR}"

# We have recipes-* directories, add to BBFILES
BBFILES += "${LAYERDIR}/recipes-*/*/*.bb \
            ${LAYERDIR}/recipes-*/*/*.bbappend"

BBFILE_COLLECTIONS += "meta-soms-in-space"
BBFILE_PATTERN_meta-soms-in-space = "^${LAYERDIR}/"
BBFILE_PRIORITY_meta-soms-in-space = "6"

LAYERDEPENDS_meta-soms-in-space = "core"
LAYERSERIES_COMPAT_meta-soms-in-space = "scarthgap"
```
